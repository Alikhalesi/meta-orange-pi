## meta-orange-pie/conf/layer.conf
```bitbake
# We have a conf and classes directory, add to BBPATH
BBPATH .= ":${LAYERDIR}"

# We have recipes-* directories, add to BBFILES
BBFILES += "${LAYERDIR}/recipes-*/*/*.bb \
            ${LAYERDIR}/recipes-*/*/*.bbappend"

BBFILE_COLLECTIONS += "meta-orange-pie"
BBFILE_PATTERN_meta-orange-pie = "^${LAYERDIR}/"
BBFILE_PRIORITY_meta-orange-pie = "6"

LAYERDEPENDS_meta-orange-pie = "core"
LAYERSERIES_COMPAT_meta-orange-pie = "kirkstone"
```

## meta-orange-pie/conf/machine/orange-pie-one.conf
```bitbake
require ./include/sun8i.inc

KERNEL_DEVICETREE = "allwinner/sun8i-h3-orangepi-one.dtb"
UBOOT_MACHINE = "orangepi_one_defconfig"
UBOOT_ARCH="arm"
UBOOT_DTB="sun8i-h3-orangepi-one.dtb"
UBOOT_DTB_BINARY="sun8i-h3-orangepi-one.dtb"

MACHINE_FEATURES += "ext4"
IMAGE_TYPEDEP:sunxi-sdimg = "ext4"
IMAGE_CLASSES +="sdcard_image-sunxi"
IMAGE_FSTYPES = "ext4 sunxi-sdimg"

MACHINE_ESSENTIAL_EXTRA_RDEPENDS = "kernel-modules kernel-module-stm-programmer"

UBOOT_LOCALVERSION = "-g${@d.getVar('SRCPV', True).partition('+')[2][0:7]}"

SPL_BINARY ?= "u-boot-sunxi-with-spl.bin"


DEFAULTTUNE = "cortexa7hf-neon-vfpv4"

IMAGE_INSTALL:append = " u-boot kernel kernel-devicetree"
```
